## build/conf/bblayers.conf
```bitbake
# POKY_BBLAYERS_CONF_VERSION is increased each time build/conf/bblayers.conf
# changes incompatibly
POKY_BBLAYERS_CONF_VERSION = "2"

BBPATH = "${TOPDIR}"
BBFILES ?= ""

# Define the base path for all layers relative to the project root
HOVER_BASE = "${@os.path.abspath(os.path.join("${TOPDIR}", ".."))}"

BBLAYERS ?= " \
  ${HOVER_BASE}/layers/meta-poky-honister/meta \
  ${HOVER_BASE}/layers/meta-poky-honister/meta-poky \
  ${HOVER_BASE}/layers/meta-poky-honister/meta-yocto-bsp \
  ${HOVER_BASE}/layers/meta-poky-honister/meta-openembedded/meta-oe \
  ${HOVER_BASE}/layers/meta-poky-honister/meta-openembedded/meta-python \
  ${HOVER_BASE}/layers/meta-poky-honister/meta-openembedded/meta-multimedia \
  ${HOVER_BASE}/layers/meta-qt5 \
  ${HOVER_BASE}/layers/meta-raspberrypi \
  ${HOVER_BASE}/layers/meta-hover \
  "
```

## layers/meta-hover/conf/layer.conf
```bitbake
# We have a conf and classes directory, add to BBPATH
BBPATH .= ":${LAYERDIR}"

# We have recipes-* directories, add to BBFILES
BBFILES += "${LAYERDIR}/recipes-*/*/*.bb \
            ${LAYERDIR}/recipes-*/*/*.bbappend"

BBFILE_COLLECTIONS += "hover"
BBFILE_PATTERN_hover = "^${LAYERDIR}/"
BBFILE_PRIORITY_hover = "9"
LAYERVERSION_hover = "4"
LAYERSERIES_COMPAT_hover = "honister"
```
